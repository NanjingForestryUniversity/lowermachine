/include/ "system-conf.dtsi"
/ {
};

/ {
	usb_phy0: usb_phy@0 {
		compatible = "ulpi-phy";
		reg = <0xe0002000 0x1000>;
		view-port = <0x170>;
		reset-gpios = <&gpio0 8 1>;
		drv-vbus;
	};
};
&usb0 {
	status = "okay";
	dr_mode = "host";
	usb-phy = <&usb_phy0>;
};
&flash0 {
	compatible = "micron,w25q256";
	reg = <0x0>;
	#address-cells = <1>;
	#size-cells = <1>;
	spi-max-frequency = <50000000>;
};

